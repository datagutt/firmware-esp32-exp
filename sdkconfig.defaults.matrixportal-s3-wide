## sdkconfig.defaults.matrixportal-s3-wide
```kconfig
CONFIG_BOARD_MATRIXPORTAL_S3_WIDE=y
CONFIG_IDF_TARGET="esp32s3"
CONFIG_HUB75_CLK_8MHZ=y
CONFIG_SWAP_COLORS=y
CONFIG_NO_INVERT_CLOCK_PHASE=y
CONFIG_HUB75_MIN_REFRESH_RATE=80
CONFIG_HUB75_PANEL_WIDTH=128
CONFIG_HUB75_PANEL_HEIGHT=64
```
